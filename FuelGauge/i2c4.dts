/dts-v1/;

/ {
	compatible = "brcm,bcm2711";

	fragment@0 {
		target = <0xffffffff>;

		__overlay__ {
			status = "okay";
			pinctrl-names = "default";
			pinctrl-0 = <0xffffffff>;
			clock-frequency = <0x186a0>;
			phandle = <0x01>;

			max17205@36 {
				compatible = "maxim,max17205";
				reg = <0x36>;
				rsense = <0x0a>;
				talrt-min = <0x00>;
				talrt-max = <0x32>;
				valrt-min = <0xbb8>;
				valrt-max = <0x1194>;
				salrt-min = <0x01>;
				salrt-max = <0x63>;
				ialrt-min = <0xffffec78>;
				ialrt-max = <0x1388>;
			};
		};
	};

	fragment@1 {
		target = <0xffffffff>;

		__dormant__ {
			brcm,pins = <0x06 0x07>;
		};
	};

	fragment@2 {
		target = <0xffffffff>;

		__overlay__ {
			brcm,pins = <0x08 0x09>;
		};
	};

	__overrides__ {
		pins_6_7 = [00 00 00 00 3d 31 21 32 00];
		pins_8_9 = [00 00 00 00 21 31 3d 32 00];
		baudrate = [00 00 00 01 63 6c 6f 63 6b 2d 66 72 65 71 75 65 6e 63 79 3a 30 00];
	};

	__symbols__ {
		frag0 = "/fragment@0/__overlay__";
	};

	__fixups__ {
		i2c4 = "/fragment@0:target:0";
		i2c4_pins = "/fragment@0/__overlay__:pinctrl-0:0\0/fragment@1:target:0\0/fragment@2:target:0";
	};

	__local_fixups__ {

		__overrides__ {
			baudrate = <0x00>;
		};
	};
};
