/dts-v1/;

/ {
	compatible = "brcm,bcm2711";

	fragment@0 {
		target = <0xffffffff>;

		__overlay__ {
			status = "okay";
			pinctrl-names = "default";
			pinctrl-0 = <0xffffffff>;
			clock-frequency = <0x186a0>;
			phandle = <0x01>;

			bleerom@50 {
				compatible = "atmel,24c08";
				reg = <0x50>;
				pagesize = <0x10>;
				num-addresses = <0x04>;
				phandle = <0x02>;
			};
		};
	};

	fragment@1 {
		target = <0xffffffff>;

		__dormant__ {
			brcm,pins = <0x02 0x03>;
		};
	};

	fragment@2 {
		target = <0xffffffff>;

		__overlay__ {
			brcm,pins = <0x04 0x05>;
		};
	};

	__overrides__ {
		pins_2_3 = [00 00 00 00 3d 31 21 32 00];
		pins_4_5 = [00 00 00 00 21 31 3d 32 00];
		baudrate = [00 00 00 01 63 6c 6f 63 6b 2d 66 72 65 71 75 65 6e 63 79 3a 30 00];
	};

	__symbols__ {
		frag0 = "/fragment@0/__overlay__";
		bleerom = "/fragment@0/__overlay__/bleerom@50";
	};

	__fixups__ {
		i2c3 = "/fragment@0:target:0";
		i2c3_pins = "/fragment@0/__overlay__:pinctrl-0:0\0/fragment@1:target:0\0/fragment@2:target:0";
	};

	__local_fixups__ {

		__overrides__ {
			baudrate = <0x00>;
		};
	};
};
